## main/Kconfig.projbuild
```kconfig
menu "WAN Configuration"

    config ESP_WIFI_SSID
        string "WiFi SSID"
        default "008"
        help
            SSID (network name) to connect.

    config ESP_WIFI_PASSWORD
        string "WiFi Password"
        default "hilfigner169"
        help
            WiFi password (WPA or WPA2).

    config ESP_MAXIMUM_RETRY
        int "Maximum retry"
        default 5
        help
            Set the Maximum retry to avoid station reconnecting to the AP unlimited when the AP is really inexistent.
endmenu

menu "APP Configuration"

    config URLFILE
        string "Remote File Address"
        default "https://www.sgo.fi/Data/RealTime/Kuvat/magrtday.png"
        help
            FILE URL which to will be download.
            
     config FILEPATHNAME
        string "Filename with Path for File"
        default "/sdcard/sgo.png"
        help
            Filename (with path) to save the content downloaded from the URL.
        
     config EXCHANG_BUF_SIZE
        int "Buffer size for from HTTP to SDcard data pass"
        default 512
        help
            Recomended 512-4096.        
     
endmenu
```
